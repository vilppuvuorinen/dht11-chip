/*
 * Copyright 2016 Cody Nybo
 *
 * This file is free software; you can redistribute it and/or modify
 * it under the terms of the GNU General Public License as published by
 * the Free Software Foundation; either version 2 of the License, or
 * (at your option) any later version.
 *
 * This file is distributed in the hope that it will be useful,
 * but WITHOUT ANY WARRANTY; without even the implied warranty of
 * MERCHANTABILITY or FITNESS FOR A PARTICULAR PURPOSE.  See the
 * GNU General Public License for more details.
 *
 *
 *
 * This device tree overlay enables a DHT11 sensor over gpio
 * Pins Used:
 * PB3  (AP-EINT3) = DHT11 Data
*/


/dts-v1/;
/plugin/;

#include <dt-bindings/pinctrl/sun4i-a10.h>
#include <dt-bindings/gpio/gpio.h>

/{
  compatible = "nextthing,chip", "allwinner,sun5i-r8";

  fragment@0 {
    target-path = "/";
    __overlay__ {
      dht11: dht11@0 {
        compatible = "dht11";
        gpios = <&pio 1 3 GPIO_ACTIVE_HIGH>;	/* dht11 pin PB3 (AP-EINT3)         */
        pinctrl-names = "default";
        pinctrl-0 = <&chip_dht11_pin>;
        status = "okay";
      };
    };
  };

  fragment@1 {
    target = <&pio>;
    __overlay__ {
      chip_dht11_pin: chip_dht11_pin@0 {
        allwinner,pins = "PB3";
        allwinner,function = "gpio_in";
        allwinner,drive = <SUN4I_PINCTRL_10_MA>;
        allwinner,pull = <SUN4I_PINCTRL_PULL_UP>;
      };
    };
  };
};
